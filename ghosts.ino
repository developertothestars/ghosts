/* ghosts.ino */
 
#include "SPI.h"
#include "ILI9341_t3.h"

#define TFT_DC  9
#define TFT_CS 10

ILI9341_t3 tft = ILI9341_t3(TFT_CS, TFT_DC);

typedef struct rgbinfo {
  char r;
  char g;
  char b;
};

typedef struct sprite {
  struct rgbinfo rgbtable[8];
  int dimx;
  int dimy;
  char *spritearray;
};

typedef struct tile {
  struct rgbinfo color;
  char data[8];
};

#define TWIDTH  28
#define THEIGHT 36
#define XOFFS    8
#define YOFFS   16

struct tile tileinfo[] = {
  {{0x00, 0x00, 0x00},
    0x00, 0x00, 0x00, 0x00, 0x00, 0x00, 0x00, 0x00},
  {{0x21, 0x21, 0xde},                               /*  1 UL2 */
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    0x00, 0x00, 0x00, 0x00, 0x00, 0x00, 0x00, 0x00}};

char tilemap[THEIGHT][TWIDTH] =
       {{ 0,  0,  0,  0,  0,  0,  0,  0,  0,  0,  0,  0,  0,  0,
          0,  0,  0,  0,  0,  0,  0,  0,  0,  0,  0,  0,  0,  0},
        { 0,  0,  0,  0,  0,  0,  0,  0,  0,  0,  0,  0,  0,  0,
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         19, 19, 19, 19, 19, 19, 19, 19, 19, 19, 19, 19, 19, 20}};

char marray[] = {6, 6, 6, 6, 6, 6, 6, 6, 6, 6, 6, 6, 6, 6,
                 6, 6, 6, 6, 6, 5, 5, 5, 5, 5, 6, 6, 6, 6,
                 6, 6, 6, 5, 5, 5, 5, 5, 5, 5, 5, 5, 6, 6,
                 6, 6, 5, 5, 5, 5, 5, 5, 5, 5, 5, 5, 5, 6,
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                 6, 6, 6, 6, 6, 6, 6, 6, 6, 6, 6, 6, 6, 6};

struct sprite mario =
  {{{0x00, 0x00, 0x00},  /* black, transparent */
    {0xff, 0x00, 0x00},  /* red */
    {0x99, 0x66, 0x00},  /* brown */
    {0xe5, 0xb8, 0x87},  /* skin tone */
    {0x00, 0x00, 0xff},  /* blue */
    {0xff, 0xff, 0x00},  /* yellow */
    {0x00, 0x00, 0x00},  /* black, not transparent */
},
   14, 15,
   marray};

char marray2[] = {6, 6, 6, 6, 6, 6, 6, 6, 6, 6, 6, 6, 6, 6,
                 6, 6, 6, 6, 6, 5, 5, 5, 5, 5, 6, 6, 6, 6,
                 6, 6, 6, 5, 5, 5, 5, 5, 5, 5, 6, 6, 6, 6,
                 6, 6, 5, 5, 5, 5, 5, 5, 5, 6, 6, 6, 6, 6,
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                 6, 6, 6, 6, 6, 6, 6, 6, 6, 6, 6, 6, 6, 6};

struct sprite mario2 =
  {{{0x00, 0x00, 0x00},  /* black, transparent */
    {0xff, 0x00, 0x00},  /* red */
    {0x99, 0x66, 0x00},  /* brown */
    {0xe5, 0xb8, 0x87},  /* skin tone */
    {0x00, 0x00, 0xff},  /* blue */
    {0xff, 0xff, 0x00},  /* yellow */
    {0x00, 0x00, 0x00},  /* black, not transparent */
},
   14, 15,
   marray2};

int posx;
int posy;
int deltax;

void drawSprite(struct sprite *s, int x, int y)
{
    int i;
    int j;
    int sz;
    int index;
    int color;

    sz = 1;
    for (i = 0; i < s->dimx; i++)
        for (j = 0; j < s->dimy; j++)
        {
        index = i + j * s->dimx;
        if (s->spritearray[index] != 0)
        tft.fillRect(x + i * sz, y + j * sz, sz, sz,
            tft.color565(s->rgbtable[s->spritearray[index]].r,
                         s->rgbtable[s->spritearray[index]].g,
                         s->rgbtable[s->spritearray[index]].b));
#if 0
        else
        {
          if ((x + y + i + j) % 2 == 0)
             color = ILI9341_BLACK;
          else
             color = ILI9341_BLUE;
          tft.fillRect(x + i * sz, y + j * sz, sz, sz, color);
        }
#endif
        }
}

void drawTile(int x, int y, struct tile tile)
{
  int color;
  int mask;
  int i;
  int j;

  color = tft.color565(tile.color.r, tile.color.g,
                       tile.color.b);
  for (i = 0; i < 8; i++)
  {
    mask = 0x80;
    for (j = 0; j < 8; j++)
    {
      if (tile.data[i] & mask)
        tft.drawPixel(x + j, y + i, color);
      mask = mask / 2;
    }
  }
}

void tileScreen(void)
{
  int i;
  int j;

  for (i = 0; i < TWIDTH; i++)
    for (j = 0; j < THEIGHT; j++)
      drawTile(XOFFS + i * 8, YOFFS + j * 8, tileinfo[tilemap[j][i]]);
}


void setup()
{
//Serial.begin(115200);
//	while (!Serial);
	
        posx = 100;
        posy =  77;
        deltax = 1;
	tft.begin();			// initialize LCD
	tft.fillScreen(ILI9341_BLACK);
        tileScreen();
}

void loop(void)
{
   int rdx;
   int rdy;
   int deltay;

#if 0
   rdx = analogRead(1);
   if (rdx < 512 - 20)
      deltax = 1;
   else if (rdx < 512 - 140)
      deltax = 2;
   else if (rdx > 512 + 20)
      deltax = -1;
   else if (rdx > 512 + 140)
      deltax = -2;
   posx = posx + deltax;
   if (posx < 10)
       posx = 10;
   if (posx > 200)
       posx = 200;
   rdy = analogRead(0);
   if (rdy < 512 - 40)
      deltay = -2;
   else if (rdy > 512 + 40)
      deltay = 2;
   posy = posy + deltay;
   if (posy < 10)
       posy = 10;
   if (posy > 200)
       posy = 200;
#endif
   posx = posx + deltax;
   if (posx > 208)
     deltax = -1 * deltax;
   if (posx < 18)
     deltax = -1 * deltax;
   if (posx & 8)
     drawSprite(&mario, posx, posy);
   else
     drawSprite(&mario2, posx, posy);
   delay(20);

// delay(50);
}

